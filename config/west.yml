## config/west.yml
```yaml
manifest:
  remotes:
    - name: zmkfirmware
      url-base: https://github.com/zmkfirmware
    - name: gpeye
      url-base: https://github.com/GPeye
    - name: tokyo2006
      url-base: https://github.com/tokyo2006
    - name: englmaxi
      url-base: https://github.com/englmaxi
  projects:
    # Mario walking animation for OLED peripheral displays (nice_view_custom shield)
    # Repo: https://github.com/GPeye/mario-peripheral-animation
    # Uncomment and use 'nice_view_custom' shield in build.yaml to enable
    # - name: mario-peripheral-animation
    #   remote: gpeye
    #   revision: main

    - name: zmk
      remote: zmkfirmware
      revision: v0.3.0
      import: app/west.yml

    # Prospector module for color LCD dongle displays (not needed for B&W OLED)
    # Repo: https://github.com/carrefinho/prospector-zmk-module
    # Features: layer roller, peripheral battery bar, connection status
    # - name: prospector-zmk-module
    #   remote: carrefinho  # (was tokyo2006 fork)
    #   revision: main

    - name: zmk-dongle-display
      remote: englmaxi
      revision: v0.3
  self:
    path: config
```
